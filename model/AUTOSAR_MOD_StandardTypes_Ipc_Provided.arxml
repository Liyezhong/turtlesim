AUTOSAR XML (schema 00047)
package /turtlesim/Ipc/Provided
  provided user defined service instance ProvidedIpcexternal_elements: service-interface=Ipcexternal_elements
package /turtlesim/Ipc/Provided/Mapping
  service instance to port prototype mapping PortMappingProvidedIpcexternal_elements: port-prototype=controller.external_elements, process=AP_controllerProcess, service-instance=ProvidedIpcexternal_elements
