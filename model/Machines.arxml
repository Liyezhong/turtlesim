AUTOSAR XML (schema 00047)
package /turtlesim/Machines/xilinxMachine
  machine xilinxMachine: machine-design=xilinxMachineDesign
    function-groups:
      mode declaration group prototype MachineState: type=RaspiMachineMachineState
    os module instantiation Os
      resource group ControlGroup: cpu-usage=50, mem-usage=4096
    processor Processor
      4 x processor core:
        ProcessorCore{0..3}
