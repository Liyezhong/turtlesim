AUTOSAR XML (schema 00047)
package /turtlesim/Someip/Required
  required someip service instance RequiredSomeipSpeedControl: service-interface=SomeipSpeedControl, required-minor-version=ANY, required-service-instance-id=2, sd-client-config=SomeipSdClientServiceInstanceConfigspeed_control
    someip required event group SomeipEventGroup: event-group=SomeipEventGroup, sd-client-event-group-timing-config=SomeipSdClientEventGroupTimingConfig
  someip sd client service instance config SomeipSdClientServiceInstanceConfigspeed_control: initial-find-behavior={initial-delay-max-value=0.1, initial-delay-min-value=0.01, initial-repetitions-base-delay=0.2, initial-repetitions-max=3}, service-find-time-to-live=3
