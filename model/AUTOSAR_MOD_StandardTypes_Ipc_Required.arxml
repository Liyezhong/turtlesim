AUTOSAR XML (schema 00047)
package /turtlesim/Ipc/Required
  required user defined service instance RequiredIpcdriving_information: service-interface=Ipcdriving_information
package /turtlesim/Ipc/Required/Mapping
  service instance to port prototype mapping PortMappingRequiredIpcdriving_information: port-prototype=controller.driving_information, process=AP_controllerProcess, service-instance=RequiredIpcdriving_information
