AUTOSAR XML (schema 00047)
package /turtlesim/Ipc
  user defined service interface deployment Ipcdriving_information: service-interface=driving_information
    user defined event deployment vehicle_speed: event=vehicle_speed
    user defined event deployment vehicle_position: event=vehicle_position
  user defined service interface deployment Ipcexternal_elements: service-interface=external_elements
    user defined field deployment lane: field=lane
      get getLane
      notifier onLane
      set setLane
    user defined field deployment object: field=object
      get getObject
      notifier onObject
      set setObject
  user defined service interface deployment Ipcspeed_control: service-interface=speed_control
    user defined event deployment LKA_speed: event=LKA_speed
    user defined event deployment ToGoal_speed: event=ToGoal_speed
package /turtlesim/Ipc/Provided
  provided user defined service instance ProvidedIpcdriving_information: service-interface=Ipcdriving_information
  provided user defined service instance ProvidedIpcspeed_control: service-interface=Ipcspeed_control
package /turtlesim/Ipc/Provided/Mapping
  service instance to port prototype mapping PortMappingProvidedIpcdriving_information: port-prototype=cswc.PPort_drivinginfomation, process=rosap_exeProcess, service-instance=ProvidedIpcdriving_information
  service instance to port prototype mapping PortMappingProvidedIpcspeed_control: port-prototype=cswc.PPort_speed_control, process=rosap_exeProcess, service-instance=ProvidedIpcspeed_control
package /turtlesim/Ipc/Required
  required user defined service instance RequiredIpcexternal_elements: service-interface=Ipcexternal_elements
package /turtlesim/Ipc/Required/Mapping
  service instance to port prototype mapping PortMappingRequiredIpcexternal_elements: port-prototype=cswc.RPort_external_elements, process=rosap_exeProcess, service-instance=RequiredIpcexternal_elements
