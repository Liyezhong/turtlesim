AUTOSAR XML (schema 00047)
package /turtlesim/Application_design/ROS_locator
  adaptive application sw component type ROS_locator_swc
  executable ROS_locator
    root sw component prototype RootSwComponentPrototype: application-type=ROS_locator_swc
