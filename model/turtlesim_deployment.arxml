AUTOSAR XML (schema 00047)
package /turtlesim/deployment
  process ros_locatior: executable=ROS_locator, state-dependent-startup-config{function-group-state=MachineState.Running, startup-config=roslocatorStartupConfig}
    process state machine ModeDeclarationGroupPrototype: type=ProcessStates
  process rosap_exeProcess: executable=rosap_exe, state-dependent-startup-config{function-group-state=MachineState.Running, startup-config=apconverterStartupConfig}
    process state machine ModeDeclarationGroupPrototype: type=ProcessStates
  mode declaration group ProcessStates: initial-mode=running
    mode running: value=0
    mode terminating: value=1
package /turtlesim/deployment/Mapping
  someip service instance to machine mapping MachineMappingprovideeSomeipTogoalspeed: communication-connector=Networkendpointraspi, service-instance=ProvidedSomeipSpeedControl, udp-port=40010
  service instance to port prototype mapping PortMappingRequiredSomeipdriving_information: port-prototype=controller.driving_information, process=AP_controllerProcess, service-instance=RequiredSomeipdriving_information
  someip service instance to machine mapping MachineMappingProvidedSomeipdriving_information: communication-connector=Networkendpoint, service-instance=ProvidedSomeipdriving_information, udp-port=48000
  service instance to port prototype mapping PortMappingRequiredSomeipSpeedControl: port-prototype=actuator.speed_control, process=ap_actuatorProcess, service-instance=RequiredSomeipSpeedControl
  someip service instance to machine mapping MachineMappingRequiredSomeipSpeedControl: communication-connector=Networkendpoint, service-instance=RequiredSomeipSpeedControl, udp-port=48001
  someip service instance to machine mapping MachineMappingRequiredSomeipdriving_information: communication-connector=Networkendpointraspi, service-instance=RequiredSomeipdriving_information, udp-port=48002
