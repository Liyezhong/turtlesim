AUTOSAR XML (schema 00047)
package /turtlesim/Someip/Provided
  provided someip service instance ProvidedSomeipSpeedControl: service-interface=SomeipSpeedControl, sd-server-config=SomeipSdServerServiceInstanceConfigspeed_control, service-instance-id=2
    someip provided event group SomeipEventGroup: event-group=SomeipEventGroup, multicast-threshold=0
  someip sd server service instance config SomeipSdServerServiceInstanceConfigspeed_control: initial-offer-behavior={initial-delay-max-value=0.1, initial-delay-min-value=0.01, initial-repetitions-base-delay=0.2, initial-repetitions-max=10}, offer-cyclic-delay=4, request-response-delay={max-value=1.5, min-value=1.5}, service-offer-time-to-live=3
